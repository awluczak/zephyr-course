## app/Kconfig
```kconfig
config APP_HEARTBEAT_PERIOD_MS
	int "App heartbeat period [ms] (100-2000)"
	range 100 2000
	default 500
	help
	    Set the period of the app heartbeat indicated by LED flashing.

source "Kconfig.zephyr"
```

## hello_world/boards/custom_board/board.yml
```yaml
board:
  name: custom_board
  full_name: Custom Board
  vendor: Adam
  socs:
    - name: stm32f103xb
```
